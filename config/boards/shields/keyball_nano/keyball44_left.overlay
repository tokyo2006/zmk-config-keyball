/*
 * Copyright (c) 2020 ZMK Contributors
 *
 * SPDX-License-Identifier: MIT
 */

#include "keyball44.dtsi"

&kscan0 {
	col-gpios
		= <&gpio0 21 GPIO_ACTIVE_HIGH>
		, <&gpio0 23 GPIO_ACTIVE_HIGH>
		, <&gpio1 9 GPIO_ACTIVE_HIGH>
		, <&gpio0 6 GPIO_ACTIVE_HIGH>
		, <&gpio0 11 GPIO_ACTIVE_HIGH>
		, <&gpio0 12 GPIO_ACTIVE_HIGH>
		;
};
